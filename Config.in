## Config.in
```kconfig
source "$BR2_EXTERNAL_PHONE_AUDIO_GUESTBOOK_PATH/package/python-pyaudio/Config.in"
```

## package/python-pyaudio/Config.in
```kconfig
config BR2_PACKAGE_PYTHON_PYAUDIO
	bool "python-pyaudio"
	help
	  Cross-platform audio I/O with PortAudio.

	  https://people.csail.mit.edu/hubert/pyaudio/
```

## package/python-pydub/Config.in
```kconfig
config BR2_PACKAGE_PYTHON_PYDUB
	bool "python-pydub"
	help
	  Manipulate audio with an simple and easy high level
	  interface.

	  http://pydub.com
```
